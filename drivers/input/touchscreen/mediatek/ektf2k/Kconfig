## drivers/input/touchscreen/mediatek/ektf2k/Kconfig
```kconfig
#
# Touchscreen driver configuration
#


config TOUCHSCREEN_MTK_ELAN2K
	bool "touchscreen driver elan2k"
	default n
```

## drivers/input/touchscreen/mediatek/ektf2k_v3702/Kconfig
```kconfig
config TOUCHSCREEN_MTK_EKTF2K_v3702
	bool "EKTF2K for v3702"
	default n
	help
	  Say Y here if you have EKTF2K touch panel.

	  If unsure, say N.

	  To compile this dirver as a module, choose M here: the
	  module will be called.
```

## drivers/misc/mediatek/sensors-1.0/accelerometer/KXTJ2_1009-new/Kconfig
```kconfig
config MTK_KXTJ3
	bool "KXTJ2_1009 for MediaTek package"
	default n
	help
	  It support different accelerometer sensor.
          If this option is set,
	  it will support
          MC3410 Accelerometer.
```
